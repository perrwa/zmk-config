## boards/shields/corne/Kconfig.defconfig
```kconfig
if SHIELD_CORNE_DONGLE

# Max 16 characters in keyboard name
config ZMK_KEYBOARD_NAME
    default "corne-dongle"

config ZMK_SPLIT_ROLE_CENTRAL
    default y

endif

if SHIELD_CORNE_LEFT || SHIELD_CORNE_RIGHT || SHIELD_CORNE_DONGLE

config ZMK_SPLIT
    default y

endif
```

## config/boards/mdbt50q_cx_40.conf
```kconfig
# Board-specific overrides for Raytac MDBT50Q-CX-40 dongle.
# Reduce RAM usage for Zephyr 4.1 compatibility — the default BLE
# controller + USB stack exceeds 256 KB on this board without tuning.

# Disable logging to save ~20-30 KB RAM
CONFIG_LOG=n
CONFIG_ZMK_LOG_LEVEL_OFF=y

# Shrink BLE controller buffers (defaults are generous)
CONFIG_BT_BUF_ACL_RX_SIZE=69
CONFIG_BT_BUF_ACL_TX_SIZE=69
CONFIG_BT_BUF_ACL_RX_COUNT=3
CONFIG_BT_BUF_ACL_TX_COUNT=3

# Reduce main/idle thread stack sizes
CONFIG_MAIN_STACK_SIZE=2048
CONFIG_IDLE_STACK_SIZE=256
CONFIG_ISR_STACK_SIZE=1536
CONFIG_SYSTEM_WORKQUEUE_STACK_SIZE=2048

# Smaller heap
CONFIG_HEAP_MEM_POOL_SIZE=4096
```
